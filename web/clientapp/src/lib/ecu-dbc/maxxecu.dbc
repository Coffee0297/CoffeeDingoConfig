VERSION ""

NS_ :

BS_:

BU_: ECU

BO_ 1312 FAST1: 8 ECU
 SG_ RPM : 0|16@1- (1,0) [0|32767] "rpm" Vector__XXX

BO_ 1328 SLOW_530: 8 ECU
 SG_ Battery_Voltage : 0|16@1- (0.01,0) [0|327.67] "V" Vector__XXX
 SG_ Coolant_Temp : 48|16@1- (0.1,0) [-3276.8|3276.7] "degC" Vector__XXX

BO_ 1334 SLOW_536: 8 ECU
 SG_ Oil_Pressure : 32|16@1- (0.1,0) [-3276.8|3276.7] "kPa" Vector__XXX

CM_ "MaxxECU default CAN output protocol v1.3 (2020-09-29), 500 kbit/s, 11-bit ids, little endian, int16 values. RPM and coolant need MaxxECU firmware 1.67 or newer; oil pressure (0x536) 1.135 or newer, and protocol 1.3 (v1.2 sends nothing in 0x536).";
CM_ "Source: https://maxxecu.com/webhelp/can-default_maxxecu_protocol.html (rows 0x520 offset 0 RPM; 0x530 offset 0 Battery voltage x0.01, offset 6 Coolant temp x0.1; 0x536 offset 4 Oil pressure x0.1).";
